## main/Kconfig.projbuild
```kconfig
menu "Example CoAP Server Configuration"

    config EXAMPLE_COAP_PSK_KEY
        string "Preshared Key (PSK) to used in the connection from the CoAP client"
        depends on COAP_MBEDTLS_PSK
        default "secret-key"
        help
            The Preshared Key to use to encrypt the communicatons. The same key must be
            used at both ends of the CoAP connection, and the CoaP client must request
            an URI prefixed with coaps:// instead of coap:// for DTLS to be used.

    config EXAMPLE_COAP_LISTEN_PORT
        string "CoAP Listen port"
        default "5683"
        help
            Port number to listen for CoAP traffic.

    config EXAMPLE_COAPS_LISTEN_PORT
        string "CoAP Secure Listen port"
        default "5684"
        depends on COAP_MBEDTLS_PSK || COAP_MBEDTLS_PKI
        help
            Port number to listen for CoAP secure ((D)TLS) traffic.

    config EXAMPLE_COAP_WEBSOCKET_PORT
        string "CoAP Websocket port"
        default "80"
        depends on COAP_WEBSOCKETS
        help
            Port number to listen for WebSocket traffic on.

            The default is 80.

    config EXAMPLE_COAP_WEBSOCKET_SECURE_PORT
        string "CoAP Websocket Secure port"
        default "443"
        depends on COAP_WEBSOCKETS && (COAP_MBEDTLS_PSK || COAP_MBEDTLS_PKI)
        help
            Port number to listen for WebSocket Secure (TLS) traffic on.

            The default is 443.

    choice EXAMPLE_COAP_MCAST_IP_MODE
        prompt "Receive Multicast IP type"
        help
            Example can receive multicast IPV4, IPV6, both or none.

        config EXAMPLE_COAP_MCAST_NONE
            bool "None"

        config EXAMPLE_COAP_MCAST_IPV4_V6
            bool "IPV4 & IPV6"
            depends on LWIP_IPV4 && LWIP_IPV6
            select EXAMPLE_COAP_MCAST_IPV4
            select EXAMPLE_COAP_MCAST_IPV6

        config EXAMPLE_COAP_MCAST_IPV4_ONLY
            bool "IPV4"
            depends on LWIP_IPV4
            select EXAMPLE_COAP_MCAST_IPV4

        config EXAMPLE_COAP_MCAST_IPV6_ONLY
            bool "IPV6"
            depends on LWIP_IPV6
            select EXAMPLE_COAP_MCAST_IPV6

    endchoice

    config EXAMPLE_COAP_MCAST_IPV4
        bool
        depends on LWIP_IPV4

    config EXAMPLE_COAP_MCAST_IPV6
        bool
        depends on LWIP_IPV6

    config EXAMPLE_COAP_MULTICAST_IPV4_ADDR
        string "CoAP Multicast IPV4 Address (receive)"
        default "224.0.1.187"
        depends on EXAMPLE_COAP_MCAST_IPV4
        help
            IPV4 multicast address to receive multicast traffic on.

            The default CoAP IPV4 address is 224.0.1.187.

    config EXAMPLE_COAP_MULTICAST_IPV6_ADDR
        string "CoAP Multicast IPV6 Address (receive)"
        default "FF02::FD"
        depends on EXAMPLE_COAP_MCAST_IPV6
        help
            IPV6 multicast address to receive multicast traffic on.

            The default CoAP FF02::FD address is a link-local multicast address.
            Consult IPV6 specifications or documentation for information about
            meaning of different IPV6 multicast ranges.

    orsource "$IDF_PATH/examples/common_components/env_caps/$IDF_TARGET/Kconfig.env_caps"

    choice BLINK_LED
        prompt "Blink LED type"
        default BLINK_LED_GPIO if IDF_TARGET_ESP32 || IDF_TARGET_ESP32C2
        default BLINK_LED_STRIP
        help
            Select the LED type. A normal level controlled LED or an addressable LED strip.
            The default selection is based on the Espressif DevKit boards.
            You can change the default selection according to your board.

        config BLINK_LED_GPIO
            bool "GPIO"
        config BLINK_LED_STRIP
            bool "LED strip"
    endchoice

    choice BLINK_LED_STRIP_BACKEND
        depends on BLINK_LED_STRIP
        prompt "LED strip backend peripheral"
        default BLINK_LED_STRIP_BACKEND_RMT if SOC_RMT_SUPPORTED
        default BLINK_LED_STRIP_BACKEND_SPI
        help
            Select the backend peripheral to drive the LED strip.

        config BLINK_LED_STRIP_BACKEND_RMT
            depends on SOC_RMT_SUPPORTED
            bool "RMT"
        config BLINK_LED_STRIP_BACKEND_SPI
            bool "SPI"
    endchoice

    config BLINK_GPIO
        int "Blink GPIO number"
        range ENV_GPIO_RANGE_MIN ENV_GPIO_OUT_RANGE_MAX
        default 5 if IDF_TARGET_ESP32
        default 18 if IDF_TARGET_ESP32S2
        default 48 if IDF_TARGET_ESP32S3
        default 8
        help
            GPIO number (IOxx) to blink on and off the LED.
            Some GPIOs are used for other purposes (flash connections, etc.) and cannot be used to blink.

    config BLINK_PERIOD
        int "Blink period in ms"
        range 10 3600000
        default 1000
        help
            Define the blinking period in milliseconds.

    config MDNS_HOSTNAME
        string "mDNS Hostname"
        default "esp32-mdns"
        help
            mDNS Hostname for example to use

    config MDNS_INSTANCE
        string "mDNS Instance Name"
        default "ESP32 with mDNS"
        help
            mDNS Instance Name for example to use

    config MDNS_PUBLISH_DELEGATE_HOST
        bool "Publish a delegated host"
        help
            Enable publishing a delegated host other than ESP32.
            The example will also add a mock service for this host.

    config MDNS_RESOLVE_TEST_SERVICES
        bool "Resolve test services"
        default n
        help
            Enable resolving test services on startup.
            These services are advertized and evaluated in automated tests.
            When executed locally, these will not be resolved and warnings appear in the log.
            Please set to false to disable initial querying to avoid warnings.

    config MDNS_ADD_MAC_TO_HOSTNAME
        bool "Add mac suffix to hostname"
        default n
        help
            If enabled, a portion of MAC address is added to the hostname, this is used
            for evaluation of tests in CI

    config MDNS_BUTTON_GPIO
        int "Button GPIO to trigger querries"
        range ENV_GPIO_RANGE_MIN ENV_GPIO_IN_RANGE_MAX
        default 0
        help
            Set the GPIO number used as mDNS test button

    config MDNS_ADD_CUSTOM_NETIF
        bool "Add user netif to mdns service"
        default n
        help
            If enabled, we try to add a custom netif to mdns service.
            Note that for using with common connection example code, we have to disable
            all predefined interfaces in mdns component setup (since we're adding one
            of the default interfaces)

endmenu
```
